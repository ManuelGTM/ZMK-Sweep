ht: hold_tap {
    compatible = "zmk,behavior-hold-tap";
    #binding-cells = <2>;
    flavor = "tap-preferred";
    tapping-term-ms = <180>;
    quick-tap-ms = <150>;
    require-prior-idle-ms = <100>;
    bindings = <&kp>, <&kp>;
};
