ht: hold_tap {
    compatible = "zmk,behavior-hold-tap";
    #binding-cells = <2>;
    flavor = "tap-preferred";
    tapping-term-ms = <180>;
    quick-tap-ms = <150>;
    require-prior-idle-ms = <100>;
    bindings = <&kp>, <&kp>;
};

nav_lt: nav_lt {
    compatible = "zmk,behavior-hold-tap";
    label = "NAV_LT";
    #binding-cells = <2>;
    tapping-term-ms = <180>;
    quick-tap-ms = <120>;
    flavor = "tap-preferred";
    bindings = <&mo &kp>;
};

sym_lt: sym_lt {
    compatible = "zmk,behavior-hold-tap";
    label = "SYM_LT";
    #binding-cells = <2>;
    tapping-term-ms = <180>;
    quick-tap-ms = <120>;
    flavor = "tap-preferred";
    bindings = <&mo &kp>;
};
