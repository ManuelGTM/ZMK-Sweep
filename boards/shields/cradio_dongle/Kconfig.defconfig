## boards/shields/cradio_dongle/Kconfig.defconfig
```kconfig
if SHIELD_CRADIO_DONGLE

config ZMK_KEYBOARD_NAME
    default "Ferris Sweep"

config ZMK_SPLIT
    default y

config ZMK_SPLIT_ROLE_CENTRAL
    default y

config ZMK_USB
    default y

config ZMK_SPLIT_BLE_CENTRAL_PERIPHERALS
    default 2

endif


if SHIELD_CRADIO_LEFT || SHIELD_CRADIO_RIGHT

config ZMK_SPLIT
    default y

endif
```
